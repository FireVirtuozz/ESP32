## esp_project/components/sensors_lib/Kconfig
```kconfig
menu "RC-Sensors"
    depends on USE_SENSORS
    
    config USE_HCSR04
        bool "HCSR04"
        default n

    config USE_INA226
        bool "INA226"
        default n
    
    config USE_KY003
        bool "KY003"
        default n

    config USE_MPU9250
        bool "MPU9250"
        default n

    config USE_BMP280
        bool "BMP280"
        default n

    config USE_RFID_RC522
        bool "RFID RC522"
        default n

    config USE_RCWL_0515
        bool "RCWL_0515"
        default n

    config USE_VL53L1X
        bool "VL53L1X"
        default n
    
    config USE_AS5600
        bool "AS5600"
        default n

    config USE_KY035
        bool "KY035"
        default n

    config USE_FC33
        bool "FC-33"
        default n

    config USE_KY033
        bool "KY033"
        default n

    config USE_KY002
        bool "KY002"
        default n
    
    config USE_KY040
        bool "KY040"
        default n

    config USE_DHT11
        bool "DHT11"
        default n

    config USE_KY020
        bool "KY020"
        default n
    
    config USE_KY018
        bool "KY018"
        default n

    config USE_KY031
        bool "KY031"
        default n

    config USE_KY017
        bool "KY017"
        default n

    config USE_KY005
        bool "KY005"
        default n

    config USE_KY022
        bool "KY022"
        default n
    
    config USE_KY021
        bool "KY021"
        default n
    
    config USE_KY004
        bool "KY004"
        default n

    config USE_KY039
        bool "KY039"
        default n

    config USE_KY032
        bool "KY032"
        default n

    config USE_KY023
        bool "KY023"
        default n
    
    config USE_DS18B20
        bool "DS18B20"
        default n
    
    config USE_LIDAR
        bool "LIDAR"
        default n
    
    config USE_BAT_ADC
        bool "BAT_ADC"
        default n
    
    config USE_ACS758
        bool "ACS758"
        default n

    config USE_GPS
        bool "GPS"
        default n

    menu "BNO085 IMU"

    config USE_BNO085
        bool "BNO085"
        default n
    
    config ACTIVATE_ACCELERATION
        bool "ACCELERATION"
        default n
        depends on USE_BNO085
    
    config ACTIVATE_LINEAR_ACCELERATION
        bool "LINEAR ACCELERATION"
        default y
        depends on USE_BNO085
    
    config ACTIVATE_ROTATION
        bool "ROTATION"
        default y
        depends on USE_BNO085

    config ACTIVATE_CLASSIFICATION
        bool "CLASSIFICATION"
        default n
        depends on USE_BNO085

    endmenu

    menu "ESP"
    config USE_ESP
        bool "ESP"
        default n
    
    config FREE_RTOS_TASK_DEBUG
        bool "FREERTOS TASK DEBUG"
        default n
        depends on USE_ESP
    endmenu


endmenu
```
