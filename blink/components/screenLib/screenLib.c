#include <stdio.h>
#include <inttypes.h>
#include "freertos/FreeRTOS.h"
#include "freertos/task.h"
#include "driver/gpio.h"
#include "driver/i2c_master.h"
#include "esp_system.h"
#include "esp_chip_info.h"
#include "esp_flash.h"
#include "esp_partition.h"
#include "esp_log.h"
#include "driver/uart.h"

// SSD1306 address
#define OLED_ADDR_DEFAULT 0x3C

uint8_t screen[128*8];

// Police 5x8 pour A-Z (chaque caractère = 5 colonnes)
const uint8_t font5x8[64][5] = {
    {0x7C,0x12,0x11,0x12,0x7C}, // A
    {0x7F,0x49,0x49,0x49,0x36}, // B
    {0x3E,0x41,0x41,0x41,0x22}, // C
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    {0x61,0x51,0x49,0x45,0x43},  // Z

    // a-z (26-51)
    {0x20,0x54,0x54,0x54,0x78}, // a
    {0x7F,0x48,0x44,0x44,0x38}, // b
    {0x38,0x44,0x44,0x44,0x20}, // c
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    {0x44,0x64,0x54,0x4C,0x44}, // z

    // 0-9 (52-61)
    {0x3E,0x51,0x49,0x45,0x3E}, // 0
    {0x00,0x42,0x7F,0x40,0x00}, // 1
    {0x42,0x61,0x51,0x49,0x46}, // 2
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    {0x06,0x49,0x49,0x29,0x1E},  // 9

    // 62 : .
    {0x00, 0x60, 0x60, 0x00, 0x00},

    // 63 : :
    {0x00, 0x36, 0x36, 0x00, 0x00}
};

void ssd1306_draw_char(uint8_t *buffer, char c, int x, int page) {
    int index = -1;

    if (c >= 'A' && c <= 'Z') {
        index = c - 'A';             // 0-25
    } else if (c >= 'a' && c <= 'z') {
        index = 26 + (c - 'a');      // 26-51
    } else if (c >= '0' && c <= '9') {
        index = 52 + (c - '0');      // 52-61
    } else if (c == '.') index = 62;
    else if (c == ':') index = 63;

    if (index == -1) return; // caractère non supporté

    for (int i = 0; i < 5; i++) {
        buffer[page * 128 + x + i] = font5x8[index][i];
    }
}

void ssd1306_draw_string(uint8_t *buffer, const char *str, int x, int page) {
    while (*str) {
        char c = *str++;
        if ((c >= 'A' && c <= 'Z') || (c >= 'a' && c <= 'z')
        || (c >= '0' && c <= '9') || c == '.' || c == ':') {
            ssd1306_draw_char(buffer, c, x, page);
        }
        x += 6; // 5 pixels de largeur + 1 pixel d'espacement
        if (x > 127) break;
    }
}


void ssd1306_setup(void)
{
    uint8_t init_cmds[] = {
        0xAE,       // Display OFF
        0x20, 0x00, // Horizontal addressing mode
        0xB0,       // Page start address 0
        0xC8,       // COM output scan direction remapped
        0x00,       // Lower column address
        0x10,       // Higher column address
        0x40,       // Display start line
        0x81, 0x7F, // Contrast
        0xA1,       // Segment remap
        0xA6,       // Normal display
        0xA8, 0x3F, // Multiplex ratio
        0xD3, 0x00, // Display offset
        0xD5, 0x80, // Display clock divide / freq
        0xD9, 0xF1, // Pre-charge period
        0xDA, 0x12, // COM pins config
        0xDB, 0x40, // VCOMH deselect level
        0x8D, 0x14, // Charge pump
        0xAF        // Display ON
    };

    ESP_ERROR_CHECK(ssd1306_send_cmd(dev_handle, init_cmds, sizeof(init_cmds)));
}

// --------- I2C Init et Scan ---------
void i2c_init(void)
{
    //config of i2c registers, gpio, start
    ESP_ERROR_CHECK(i2c_new_master_bus(&i2c_mst_config, &bus_handle));

    //check if the adress is known
    ESP_ERROR_CHECK(i2c_master_probe(bus_handle, OLED_ADDR_DEFAULT, -1));

    //add the address of the device on the master bus
    ESP_ERROR_CHECK(i2c_master_bus_add_device(bus_handle, &dev_cfg, &dev_handle));
}

void oled_blink_task(void *pvParameter)
{
    uint8_t buffer_on[128*8];
    uint8_t buffer_off[128*8];
    memset(buffer_on, 0xFF, sizeof(buffer_on));   // pixels allumés
    memset(buffer_off, 0x00, sizeof(buffer_off)); // pixels éteints

    while (1) {
        // Allume tout l'écran
        ssd1306_send_data(dev_handle, buffer_on, sizeof(buffer_on));
        vTaskDelay(pdMS_TO_TICKS(500)); // 500 ms ON

        // Éteint tout l'écran
        ssd1306_send_data(dev_handle, buffer_off, sizeof(buffer_off));  
        vTaskDelay(pdMS_TO_TICKS(500)); // 500 ms OFF
    }
}