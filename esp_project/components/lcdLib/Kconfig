## esp_project/components/ledLib/Kconfig
```kconfig
menu "RC-LED-LEDC"
    depends on USE_LEDLIB

    config DEBUG_LEDC
        bool "DEBUG LEDC"
        default n

    config DEBUG_GPIO
        bool "DEBUG GPIO"
        default n
    
    config WRITE_MOTOR_SCREEN
        bool "Write motor on screen"
        default n
        depends on USE_SCREENLIB

    config WRITE_ANGLE_SCREEN
        bool "Write angle on screen"
        default n
        depends on USE_SCREENLIB

    config USE_BTS7960
        bool "BTS7960"
        default n
    
    config USE_MG996R
        bool "MG996R"
        default n

    config USE_KY006
        bool "KY006"
        default n

    config USE_KY029
        bool "KY029"
        default n

    config USE_KY009
        bool "KY009"
        default n

    config USE_BUILTIN_LED
        bool "BUILTIN LED"
        default n

    config SAVE_LED
        bool "Save LED state to NVS"
        default n
        depends on USE_BUILTIN_LED
    
    config USE_BUILTIN_LED_W2812B
        bool "BUILTIN LED W2812B"
        default n

endmenu
```

## esp_project/components/sensorsLib/Kconfig
```kconfig
menu "RC-Sensors"
    depends on USE_SENSORS
    
    config USE_HCSR04
        bool "HCSR04"
        default n

    config USE_INA226
        bool "INA226"
        default n
    
    config USE_KY003
        bool "KY003"
        default n

    config USE_MPU9250
        bool "MPU9250"
        default n

    config USE_RFID_RC522
        bool "RFID RC522"
        default n

    config USE_RCWL_0515
        bool "RCWL_0515"
        default n

    config USE_VL53L1X
        bool "VL53L1X"
        default n
    
    config USE_AS5600
        bool "AS5600"
        default n

    config USE_KY035
        bool "KY035"
        default n

    config USE_FC33
        bool "FC-33"
        default n

    config USE_KY033
        bool "KY033"
        default n

    config USE_KY002
        bool "KY002"
        default n
    
    config USE_KY040
        bool "KY040"
        default n

    config USE_DHT11
        bool "DHT11"
        default n

    config USE_KY020
        bool "KY020"
        default n
    
    config USE_KY018
        bool "KY018"
        default n

    config USE_KY031
        bool "KY031"
        default n

    config USE_KY017
        bool "KY017"
        default n

    config USE_KY005
        bool "KY005"
        default n

    config USE_KY022
        bool "KY022"
        default n
    
    config USE_KY021
        bool "KY021"
        default n
    
    config USE_KY004
        bool "KY004"
        default n

    config USE_KY039
        bool "KY039"
        default n

    config USE_KY032
        bool "KY032"
        default n

    config USE_KY023
        bool "KY023"
        default n

    menu "ESP"
    config USE_ESP
        bool "ESP"
        default n
    
    config FREE_RTOS_TASK_DEBUG
        bool "FREERTOS TASK DEBUG"
        default n
        depends on USE_ESP
    endmenu


endmenu
```

## esp_project/components/wifiLib/Kconfig
```kconfig
menu "RC-Wifi"
    depends on USE_WIFI

    config USE_AP_MODE
        bool "AP_MODE"
        default y
    
    config USE_STA_MODE
        bool "STA_MODE"
        default n

    config DEBUG_WIFI
        bool "DEBUG_ALLOWED"
        default n

endmenu
```

## server/components/cameraLib/Kconfig
```kconfig
menu "RC-Camera"

    depends on USE_CAMERA

    choice CAM_RESOLUTION
        prompt "Camera resolution"
        default CAM_RES_QQVGA

        config CAM_RES_QQVGA
            bool "QQVGA (160x120)"
            
        config CAM_RES_QVGA
            bool "QVGA (320x240)"
            
        config CAM_RES_VGA
            bool "VGA (640x480)"
    endchoice

    choice CAM_FORMAT
        prompt "Camera format"
        default CAM_FORMAT_JPEG

        config CAM_FORMAT_JPEG
            bool "JPEG"
            
        config CAM_FORMAT_YUV
            bool "YUV"
            
        config CAM_FORMAT_RGB
            bool "RGB"
    endchoice

    config FPS_COUNT
        bool "FPS COUNT"
        default n

endmenu
```

## server/components/ledLib/Kconfig
```kconfig
menu "RC-LED-LEDC"
    depends on USE_LEDLIB

    config DEBUG_LEDC
        bool "DEBUG LEDC"
        default n

    config DEBUG_GPIO
        bool "DEBUG GPIO"
        default n
    
    config WRITE_MOTOR_SCREEN
        bool "Write motor on screen"
        default n
        depends on USE_SCREENLIB

    config WRITE_ANGLE_SCREEN
        bool "Write angle on screen"
        default n
        depends on USE_SCREENLIB

endmenu
```

## server/components/logLib/Kconfig
```kconfig
menu "RC-Log"

    config LOG_UDP
        bool "Log through UDP"
        default n
        depends on USE_UDPLIB
    
    config LOG_ESPNOW
        bool "Log through ESPNOW"
        default n
        depends on USE_ESPNOW

    config LOG_MQTT
        bool "Log through MQTT"
        default n
        depends on USE_MQTTLIB
    
    config LOG_SERIAL
        bool "Log through Serial"
        default n

endmenu
```

## server/components/sensorsLib/Kconfig
```kconfig
menu "RC-Sensors"
    depends on USE_SENSORS
    
    config USE_HCSR04
        bool "HCSR04"
        default n

    config USE_INA226
        bool "INA226"
        default n
    
    config USE_KY003
        bool "KY003"
        default n

    config USE_MPU9250
        bool "MPU9250"
        default n

    config USE_RFID_RC522
        bool "RFID RC522"
        default n

endmenu
```

## server/components/udpLib/Kconfig
```kconfig
menu "RC-UDP"
    depends on USE_WIFI && USE_UDPLIB

    config PACKET_DEBUG
        bool "DEBUG PACKETS"
        default n

    config VID_DEBUG
        bool "DEBUG VIDEO"
        default n
endmenu
```

## server/main/Kconfig.projbuild
```kconfig
menu "ESP RC Car"

    config ESP_ID
        int "Unique ESP ID"
        range 0 255
        default 0

    config USE_LEDLIB
        bool "LED library"
        default y

    menu "Screen"
    config USE_SCREENLIB
        bool "Screen library"
        default n
    
    config USE_LVGL_SCREEN
        bool "LVGL screen"
        default n
        depends on USE_SCREENLIB
    endmenu

    config USE_SENSORS
        bool "Sensors"
        default n

    config USE_CAMERA
        bool "Camera"
        default n

    menu "Wifi"
    config USE_WIFI
        bool "WiFi"
        default y

    config USE_UDPLIB
        bool "UDP"
        default y
        depends on USE_WIFI

    config USE_WSLIB
        bool "WebSocket"
        default n
        depends on USE_WIFI

    config USE_MQTTLIB
        bool "MQTT"
        default n
        depends on USE_WIFI

    config USE_OTA
        bool "OTA"
        default n
        depends on USE_WIFI
    
    config USE_ESPNOW
        bool "ESP-NOW"
        default n
        depends on USE_WIFI
    endmenu


endmenu
```
